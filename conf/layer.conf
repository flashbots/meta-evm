## conf/layer.conf
```bitbake
# We have a conf and classes directory, append to BBPATH
BBPATH .= ":${LAYERDIR}"

# We have a recipes directory, add to BBFILES
BBFILES += "${LAYERDIR}/recipes*/*/*.bb ${LAYERDIR}/recipes*/*/*.bbappend"

BBFILE_COLLECTIONS += "meta-evm"
BBFILE_PATTERN_meta-evm := "^${LAYERDIR}/"
# Layers with higher priority values take precedence over layers with lower priority values. 
# meta-evm is configured to override meta-confidential-compute layer (priority 20).
BBFILE_PRIORITY_meta-evm = "30"
LAYERVERSION_meta-evm = "4"
LAYERSERIES_COMPAT_meta-evm = "scarthgap"
```
